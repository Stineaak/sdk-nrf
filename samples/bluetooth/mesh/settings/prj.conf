## CMakeLists.txt
```
cmake_minimum_required(VERSION 3.13.1)

find_package(Zephyr REQUIRED HINTS $ENV{ZEPHYR_BASE})
project(NONE)

target_sources(app PRIVATE
	src/main.c)
target_include_directories(app PRIVATE include)
```

## prj.conf
```kconfig
#
# Copyright (c) 2019 Nordic Semiconductor ASA
#
# SPDX-License-Identifier: LicenseRef-BSD-5-Clause-Nordic
#

# CONFIG_SERIAL=y # needed?

# General configuration
CONFIG_MAIN_STACK_SIZE=4096
CONFIG_SYSTEM_WORKQUEUE_STACK_SIZE=4096
CONFIG_FLASH=y
CONFIG_FLASH_MAP=y
CONFIG_FCB=y
CONFIG_SETTINGS=y
CONFIG_HWINFO=y
CONFIG_ASSERT=y
CONFIG_ASSERT_LEVEL=2
CONFIG_LOG=y
CONFIG_LOG_PRINTK=y

CONFIG_DK_LIBRARY=y
CONFIG_BT_MESH_DK_PROV=y

# Bluetooth configuration
CONFIG_BT=y
CONFIG_BT_COMPANY_ID=0x0059
CONFIG_BT_DEVICE_NAME="Mesh TXP Control"
CONFIG_BT_L2CAP_RX_MTU=69
CONFIG_BT_L2CAP_TX_MTU=69
CONFIG_BT_L2CAP_TX_BUF_COUNT=32
CONFIG_BT_LL_SW_SPLIT=y
CONFIG_BT_OBSERVER=y
CONFIG_BT_PERIPHERAL=y
CONFIG_BT_SETTINGS=y
CONFIG_BT_TINYCRYPT_ECC=y

# Disable unused Bluetooth features
CONFIG_BT_CTLR_DUP_FILTER_LEN=0
CONFIG_BT_CTLR_LE_ENC=n
CONFIG_BT_DATA_LEN_UPDATE=n
CONFIG_BT_PHY_UPDATE=n
CONFIG_BT_CTLR_CHAN_SEL_2=n
CONFIG_BT_CTLR_MIN_USED_CHAN=n
CONFIG_BT_CTLR_PRIVACY=n

# Bluetooth Mesh configuration
CONFIG_BT_MESH=y
CONFIG_BT_MESH_RELAY=y
CONFIG_BT_MESH_FRIEND=y
CONFIG_BT_MESH_ADV_BUF_COUNT=64
CONFIG_BT_MESH_TX_SEG_MAX=32
CONFIG_BT_MESH_PB_GATT=y
CONFIG_BT_MESH_GATT_PROXY=y

# ADDED: Enable TX Power dynamic control
CONFIG_BT_CTLR_ADVANCED_FEATURES=y
CONFIG_BT_CTLR_TX_PWR_DYNAMIC_CONTROL=y

# Bluetooth Mesh models
# CONFIG_BT_MESH_ONOFF_CLI=y
```

## src/main.c
```c
/*
 * Copyright (c) 2021 Nordic Semiconductor ASA
 *
 * SPDX-License-Identifier: LicenseRef-BSD-5-Clause-Nordic
 */

#include <zephyr/types.h>
#include <stddef.h>
#include <sys/printk.h>
#include <sys/util.h>
#include <sys/byteorder.h>

#include <bluetooth/bluetooth.h>
#include <bluetooth/hci.h>
#include <bluetooth/hci_vs.h>

#include <bluetooth/conn.h>
#include <bluetooth/uuid.h>
#include <bluetooth/gatt.h>
#include <bluetooth/services/hrs.h>

#include <bluetooth/mesh.h>
#include <bluetooth/mesh/models.h>
#include <bluetooth/mesh/dk_prov.h>
#include <dk_buttons_and_leds.h>

//#include "settings_mod.h"
#define BT_MESH_NORDIC_SEMI_COMPANY_ID 0x0059
#define DEVICE_BEACON_TXPOWER_NUM  8
// ONOFF Server [Testing]

static void TEST_set_tx_power(uint8_t handle_type, uint16_t handle, uint8_t txp_lvl)
{
	struct bt_hci_cp_vs_write_tx_power_level *cp; // command power (?)
	struct bt_hci_rp_vs_write_tx_power_level *rp; // real power (?)
	struct net_buf *buf, *rsp = NULL;
	int err;

	// Allocate a HCI command buffer
	buf = bt_hci_cmd_create(BT_HCI_OP_VS_WRITE_TX_POWER_LEVEL,
				sizeof(*cp));
	if (!buf) {
		printk("Unable to allocate command buffer\n");
		return;
	}

	cp = net_buf_add(buf, sizeof(*cp));
	cp->handle = sys_cpu_to_le16(handle);
	cp->handle_type = handle_type;
	cp->tx_power_level = txp_lvl;

	//Send a HCI command synchronously
	err = bt_hci_cmd_send_sync(BT_HCI_OP_VS_WRITE_TX_POWER_LEVEL,
				   buf, &rsp);
	if (err) {
		uint8_t reason = rsp ?
			((struct bt_hci_rp_vs_write_tx_power_level *)
			  rsp->data)->status : 0;
		printk("Set Tx power err: %d reason 0x%02x\n", err, reason);
		return;
	}

	rp = (void *)rsp->data;
	printk("Actual Tx Power: %d\n", rp->selected_tx_power);

	net_buf_unref(rsp);
}


static void TEST_get_tx_power(uint8_t handle_type, uint16_t handle, uint8_t *txp_lvl)
{
	struct bt_hci_cp_vs_read_tx_power_level *cp;
	struct bt_hci_rp_vs_read_tx_power_level *rp;
	struct net_buf *buf, *rsp = NULL;
	int err;

	*txp_lvl = 0xFF;
	buf = bt_hci_cmd_create(BT_HCI_OP_VS_READ_TX_POWER_LEVEL,
				sizeof(*cp));
	if (!buf) {
		printk("Unable to allocate command buffer\n");
		return;
	}

	cp = net_buf_add(buf, sizeof(*cp));
	cp->handle = sys_cpu_to_le16(handle);
	cp->handle_type = handle_type;

	err = bt_hci_cmd_send_sync(BT_HCI_OP_VS_READ_TX_POWER_LEVEL,
				   buf, &rsp);
	if (err) {
		uint8_t reason = rsp ?
			((struct bt_hci_rp_vs_read_tx_power_level *)
			  rsp->data)->status : 0;
		printk("Read Tx power err: %d reason 0x%02x\n", err, reason);
		return;
	}

	rp = (void *)rsp->data;
	*txp_lvl = rp->tx_power_level;

	net_buf_unref(rsp);
}

static void led_set(struct bt_mesh_onoff_srv *srv, struct bt_mesh_msg_ctx *ctx,
		    const struct bt_mesh_onoff_set *set,
		    struct bt_mesh_onoff_status *rsp)
{
	printk("LED set testing...\n");

	static struct bt_conn *default_conn;
	default_conn = NULL;
	int8_t txp_get = 0xFF;
	
	static const int8_t txp[DEVICE_BEACON_TXPOWER_NUM] = {4, 0, -3, -8,
						    -15, -18, -23, -30};
	uint8_t idx = 3;

	if (!default_conn) {

			printk("Get initial Tx power level -> ");
			TEST_get_tx_power(BT_HCI_VS_LL_HANDLE_TYPE_ADV,
				     0, &txp_get);
			printk("TXP = %d\n", txp_get);

			k_sleep(K_SECONDS(5));

			printk("Set Tx power level to %d\n", txp[idx]);
			TEST_set_tx_power(BT_HCI_VS_LL_HANDLE_TYPE_ADV,
				     0, txp[idx]);

			k_sleep(K_SECONDS(5));

			printk("New Tx power level -> ");
			TEST_get_tx_power(BT_HCI_VS_LL_HANDLE_TYPE_ADV,
				     0, &txp_get);
			printk("TXP = %d\n", txp_get);
	}
}

static void led_get(struct bt_mesh_onoff_srv *srv, struct bt_mesh_msg_ctx *ctx,
		    struct bt_mesh_onoff_status *rsp)
{
	printk("LED get\n");
}

static const struct bt_mesh_onoff_srv_handlers onoff_handlers = {
	.set = led_set,
	.get = led_get,
	//.set = handle_set_message,
	//.get = handle_get_message,
};

static struct bt_mesh_onoff_srv onoff_srv = BT_MESH_ONOFF_SRV_INIT(&onoff_handlers);


// *********************** SNURRE I GANG BT MESH ************************

/** Configuration server definition */
static struct bt_mesh_cfg_srv cfg_srv = {
	.relay = IS_ENABLED(CONFIG_BT_MESH_RELAY),
	.beacon = BT_MESH_BEACON_ENABLED,
	.frnd = IS_ENABLED(CONFIG_BT_MESH_FRIEND),
	.gatt_proxy = IS_ENABLED(CONFIG_BT_MESH_GATT_PROXY),
	.default_ttl = 7,

	/* 3 transmissions with 20ms interval */
	.net_transmit = BT_MESH_TRANSMIT(2, 20),
	.relay_retransmit = BT_MESH_TRANSMIT(2, 20),
};

/* Set up a repeating delayed work to blink the DK's LEDs when attention is
 * requested.
 */
static struct k_delayed_work attention_blink_work;

static void attention_blink(struct k_work *work)
{
	static int idx;
	const uint8_t pattern[] = {
		BIT(0) | BIT(1),
		BIT(1) | BIT(2),
		BIT(2) | BIT(3),
		BIT(3) | BIT(0),
	};

	dk_set_leds(pattern[idx++ % ARRAY_SIZE(pattern)]);
	k_delayed_work_submit(&attention_blink_work, K_MSEC(30));
}

static void attention_on(struct bt_mesh_model *mod)
{
	k_delayed_work_submit(&attention_blink_work, K_NO_WAIT);
}

static void attention_off(struct bt_mesh_model *mod)
{
	k_delayed_work_cancel(&attention_blink_work);
	dk_set_leds(DK_NO_LEDS_MSK);
}

static const struct bt_mesh_health_srv_cb health_srv_cb = {
	.attn_on = attention_on,
	.attn_off = attention_off,
};

static struct bt_mesh_health_srv health_srv = {
	.cb = &health_srv_cb,
};

BT_MESH_HEALTH_PUB_DEFINE(health_pub, 0);

// ENDRES TIL KORREKT MODELL
static struct bt_mesh_elem elements[] = {
	BT_MESH_ELEM(1,
		     BT_MESH_MODEL_LIST(BT_MESH_MODEL_CFG_SRV(&cfg_srv),
					BT_MESH_MODEL_HEALTH_SRV(&health_srv,
								 &health_pub),
					BT_MESH_MODEL_ONOFF_SRV(&onoff_srv)), // BARE ENDRE DENNE LINJEN
		     BT_MESH_MODEL_NONE),
};

static const struct bt_mesh_comp comp = {
	.cid = BT_MESH_NORDIC_SEMI_COMPANY_ID,
	.elem = elements,
	.elem_count = ARRAY_SIZE(elements),
};

const struct bt_mesh_comp *model_handler_init(void)
{
	k_delayed_work_init(&attention_blink_work, attention_blink);

	// INITIALIZATION IF NEEDED

	return &comp;
}

// *********************************************************************

static void bt_ready(int err)
{
	if (err) {
		printk("Bluetooth init failed (err %d)\n", err);
		return;
	}

	printk("Bluetooth initialized\n");

	dk_leds_init();
	dk_buttons_init(NULL);

	err = bt_mesh_init(bt_mesh_dk_prov_init(), model_handler_init());
	if (err) {
		printk("Initializing mesh failed (err %d)\n", err);
		return;
	}

	if (IS_ENABLED(CONFIG_SETTINGS)) {
		settings_load();
	}

	/* This will be a no-op if settings_load() loaded provisioning info */
	bt_mesh_prov_enable(BT_MESH_PROV_ADV | BT_MESH_PROV_GATT);

	printk("Mesh initialized\n");
}

void main(void)
{
	int err;

	printk("Initializing...\n");

	err = bt_enable(bt_ready);
	if (err) {
		printk("Bluetooth init failed (err %d)\n", err);
	}
}
```

## include/settings_cli.h
```c
#include <bluetooth/mesh/model_types.h>
#include "settings_mod.h"

#ifdef __cplusplus
extern "C" {
#endif

/* Node composition data */  // The node composition data is passed to bt_mesh_init()

extern const struct bt_mesh_model_op _bt_mesh_settings_cli_op[];
extern const struct bt_mesh_model_cb _bt_mesh_settings_cli_cb;
static struct bt_mesh_model_pub pub_ctx;

#define BT_MESH_MODEL_SETTINGS_CLI(_cli)	
    BT_MESH_MODEL_VND_CB(
        BT_MESH_NORDIC_SEMI_COMPANY_ID, BT_MESH_MODEL_ID_SETTINGS_CLI,
        _bt_mesh_settings_cli_op,
        &pub_ctx, // for publishing SET messages // &(_cli)->pub (?)
        BT_MESH_MODEL_USER_DATA(struct bt_mesh_settings_cli, _cli),
        &_bt_mesh_settings_cli_cb) // enable callbacks


/* Client Initialization  */

// DO: Define bt_mesh_settings_cli ...

#define BT_MESH_SETTINGS_CLI_INIT(_status_handler)                                \
	{                                                                      \
		.status_handler = _status_handler,                             \
		.pub = {.msg = NET_BUF_SIMPLE(BT_MESH_MODEL_BUF_LEN(           \
				BT_MESH_DEVICE_SETTINGS_SET_OP,                          \
				BT_MESH_DEVICE_SETTINGS_MSG_MAXLEN_SET)) }               \
	}


/* Message handlers */

static void handle_status_message(struct bt_mesh_model *model,
			  struct bt_mesh_msg_ctx *ctx,
			  struct net_buf_simple *buf);
```

## include/settings_mod.h
```c
#include <stdlib.h>
#include "model_utils.h"
#include <bluetooth/mesh/models.h>

// Defining model identifiers

#define BT_MESH_NORDIC_SEMI_COMPANY_ID 0x0059
#define BT_MESH_MODEL_ID_SETTINGS_CLI 0x0005
#define BT_MESH_MODEL_ID_SETTINGS_SRV 0x0006 

// Defining OPcodes for messages

#define BT_MESH_DEVICE_SETTINGS_GET_OP  
    BT_MESH_MODEL_OP_3(0x01, BT_MESH_NORDIC_SEMI_COMPANY_ID)
#define BT_MESH_DEVICE_SETTINGS_SET_OP    
    BT_MESH_MODEL_OP_3(0x02, BT_MESH_NORDIC_SEMI_COMPANY_ID)
#define BT_MESH_DEVICE_SETTINGS_STATUS_OP    
    BT_MESH_MODEL_OP_3(0x03, BT_MESH_NORDIC_SEMI_COMPANY_ID)

// DO: add MESSAGE_ACK_OPCODE

#define BT_MESH_DEVICE_SETTINGS_MSG_MINLEN_GET 0 
#define BT_MESH_DEVICE_SETTINGS_MSG_MINLEN_SET 2
#define BT_MESH_DEVICE_SETTINGS_MSG_MAXLEN_SET 5
#define BT_MESH_DEVICE_SETTINGS_MSG_MINLEN_STATUS 2

/** Mandatory parameters for the Settings Set message. */
struct bt_mesh_settings_set {
	/** State to set. */
	int8_t txp_value;
	/** Transition parameters. */
	const struct bt_mesh_model_transition *transition;
};

/** Parameters for the Settings Status message. */
struct bt_mesh_settings_status {
	/** The present value of the Generic OnOff state. */
	
    int8_t txp_present;

	/** Remaining time value in milliseconds. */
	int32_t remaining_time;
};
```

## include/settings_srv.h
```c
#include <bluetooth/mesh/model_types.h>
#include "settings_mod.h"

#ifdef __cplusplus
extern "C" {
#endif

/*Node composition data */  // The node composition data is passed to bt_mesh_init()

extern const struct bt_mesh_model_op _bt_mesh_settings_srv_op[];
extern const struct bt_mesh_model_cb _bt_mesh_settings_srv_cb;

#define BT_MESH_MODEL_SETTINGS_SRV(_srv)	
    BT_MESH_MODEL_VND_CB(
        BT_MESH_NORDIC_SEMI_COMPANY_ID, BT_MESH_MODEL_ID_SETTINGS_SRV,
        _bt_mesh_settings_srv_op,
        NULL,
        BT_MESH_MODEL_USER_DATA(struct bt_mesh_settings_srv, _srv),
        &_bt_mesh_settings_srv_cb)


/* Client Initialization */

// DO: Define bt_mesh_settings_srv ...


/* Message handlers */

static void handle_get_message(struct bt_mesh_model *model,
                                  struct bt_mesh_msg_ctx *ctx,
                                  struct net_buf_simple *buf);

static void handle_set_message(struct bt_mesh_model *model,
                                  struct bt_mesh_msg_ctx *ctx,
                                  struct net_buf_simple *buf);                                


/* GET AND SET TX POWER LEVEL ON LOCAL SERVER */ 
static void set_tx_power(uint8_t handle_type, uint16_t handle, int8_t txp_lvl):
static void get_tx_power(uint8_t handle_type, uint16_t handle, int8_t *txp_lvl);

};
```

## src/settings_cli.c
```c
#include <stdlib.h>
#include "settings_cli.h"
#include "model_utils.h"
#include <bluetooth/mesh/models.h>

/* Receiving messages */ 

// Message handlers: bt_mesh_model_op.func, used to process the received message
static void handle_status_message(struct bt_mesh_model *model,
                                  struct bt_mesh_msg_ctx *ctx,
                                  struct net_buf_simple *buf)
{
    // DO: Message handler code...
}

// OPcode list - defines a list of messages that the client will receive
const struct bt_mesh_model_op _bt_mesh_settings_cli_op[] = {
    { BT_MESH_DEVICE_SETTINGS_STATUS_OP,    BT_MESH_DEVICE_SETTINGS_MSG_MINLEN_STATUS,    handle_message_status },
    BT_MESH_MODEL_OP_END,
}

/* Sending messages */

static int send_get_message(struct bt_mesh_settings_cli *cli,
			  struct bt_mesh_msg_ctx *ctx,
			  struct bt_mesh_settings_status *rsp) // (struct bt_mesh_model *model, uint16_t addr)
{
    // DO: check on specific node? :
	
	/* If you want your model to control a destination address,
     or some other parameters of a message,
     you can initialize bt_mesh_msg_ctx with custom parameters: */
    /*struct bt_mesh_msg_ctx ctx = {
            .addr = addr,
            .app_idx = model->keys[0],
            .send_ttl = BT_MESH_TTL_DEFAULT,
    };*/

    // prepare a buffer that will contain the message data together with the opcode:
    BT_MESH_MODEL_BUF_DEFINE(buf, 
        BT_MESH_DEVICE_SETTINGS_GET_OP,
        BT_MESH_DEVICE_SETTINGS_MSG_MINLEN_GET);
    // set the opcode of the message:
    bt_mesh_model_msg_init(&buf, BT_MESH_DEVICE_SETTINGS_GET_OP);

    // DO: Fill the message buffer here: ->get_txp()

    return bt_mesh_model_send(model, &ctx, &buf, NULL, NULL);
}

// Initialize the publication buffer for SET message
static struct bt_mesh_model_pub pub_ctx = {
    .msg = NET_BUF_SIMPLE(BT_MESH_MODEL_BUF_LEN(BT_MESH_DEVICE_SETTINGS_SET_OP,
                                                BT_MESH_DEVICE_SETTINGS_MSG_MAXLEN_SET)),
}

//static int update_handler(struct bt_mesh_model *model) // DO: complete

static int send_set_message(struct bt_mesh_settings_cli *cli,
			  struct bt_mesh_msg_ctx *ctx,
			  const struct bt_mesh_settings_set *set,
			  struct bt_mesh_settings_status *rsp)    // DO: fix parameters...
{

    // prepare a buffer that will contain the message data together with the opcode:
    BT_MESH_MODEL_BUF_DEFINE(buf, 
        BT_MESH_DEVICE_SETTINGS_SET_OP,
        BT_MESH_DEVICE_SETTINGS_MSG_MINLEN_SET);
    
	// set the opcode of the message:
    bt_mesh_model_msg_init(&buf, BT_MESH_DEVICE_SETTINGS_SET_OP);

	// add to buffer:
	net_buf_simple_add_u8(&buf, set->txp_value);

    return bt_mesh_model_send(model, &ctx, &buf, NULL, NULL);
}


/* Callbacks: -> Additional model initialization */
static int bt_mesh_settings_cli_init(struct bt_mesh_model *model)
{
	struct bt_mesh_settings_cli *cli = model->user_data;

	cli->model = model;
	net_buf_simple_init(cli->pub.msg, 0);
	model_ack_init(&cli->ack_ctx);

	return 0;
}

const struct bt_mesh_model_cb _bt_mesh_settings_cli_cb = {
	.init = bt_mesh_settings_cli_init,
};



/* ONOFF CLIENT:

int bt_mesh_onoff_cli_get(struct bt_mesh_onoff_cli *cli,
			  struct bt_mesh_msg_ctx *ctx,
			  struct bt_mesh_onoff_status *rsp)
{
	BT_MESH_MODEL_BUF_DEFINE(msg, BT_MESH_ONOFF_OP_GET,
				 BT_MESH_ONOFF_MSG_LEN_GET);
	bt_mesh_model_msg_init(&msg, BT_MESH_ONOFF_OP_GET);

	return model_ackd_send(cli->model, ctx, &msg,
			       rsp ? &cli->ack_ctx : NULL,
			       BT_MESH_ONOFF_OP_STATUS, rsp);
}

int bt_mesh_onoff_cli_set(struct bt_mesh_onoff_cli *cli,
			  struct bt_mesh_msg_ctx *ctx,
			  const struct bt_mesh_onoff_set *set,
			  struct bt_mesh_onoff_status *rsp)
{
	BT_MESH_MODEL_BUF_DEFINE(msg, BT_MESH_ONOFF_OP_SET,
				 BT_MESH_ONOFF_MSG_MAXLEN_SET);
	bt_mesh_model_msg_init(&msg, BT_MESH_ONOFF_OP_SET);

	net_buf_simple_add_u8(&msg, set->on_off);
	net_buf_simple_add_u8(&msg, cli->tid++);
	if (set->transition) {
		model_transition_buf_add(&msg, set->transition);
	}

	return model_ackd_send(cli->model, ctx, &msg,
			       rsp ? &cli->ack_ctx : NULL,
			       BT_MESH_ONOFF_OP_STATUS, rsp);
}

*/
```

## src/settings_cli.h
```c
#include <bluetooth/mesh/model_types.h>
#include "settings_mod.h"

#ifdef __cplusplus
extern "C" {
#endif

// Node composition data - The node composition data is passed to bt_mesh_init()

extern const struct bt_mesh_model_op _bt_mesh_settings_cli_op[];
extern const struct bt_mesh_model_cb _bt_mesh_settings_cli_cb;
static struct bt_mesh_model_pub pub_ctx;

#define BT_MESH_MODEL_SETTINGS_CLI(_cli)	
    BT_MESH_MODEL_VND_CB(
        BT_MESH_NORDIC_SEMI_COMPANY_ID, BT_MESH_MODEL_ID_SETTINGS_MOD,
        _bt_mesh_settings_cli_op,
        &pub_ctx, // for publishing SET messages
        NULL,
        NULL)
```

## src/settings_mod.h
```c
#include <stdlib.h>
#include "model_utils.h"
#include <bluetooth/mesh/models.h>
#include <modules/hal/nordic/nrfx/hal/nrf_radio.h>

// Defining model identifiers

#define BT_MESH_NORDIC_SEMI_COMPANY_ID 0x0059
#define BT_MESH_MODEL_ID_SETTINGS_MOD 0x0005 // DO: get new model id

// Defining OPcodes for messages

#define MESSAGE_DEVICE_SETTINGS_GET_OP    
    BT_MESH_MODEL_OP_3(0x01, BT_MESH_NORDIC_SEMI_COMPANY_ID)
#define MESSAGE_DEVICE_SETTINGS_SET_OP    
    BT_MESH_MODEL_OP_3(0x02, BT_MESH_NORDIC_SEMI_COMPANY_ID)
#define MESSAGE_DEVICE_SETTINGS_STATUS_OP    
    BT_MESH_MODEL_OP_3(0x03, BT_MESH_NORDIC_SEMI_COMPANY_ID)

#define BT_MESH_DEVICE_SETTINGS_MSG_MINLEN_GET 0 
#define BT_MESH_DEVICE_SETTINGS_MSG_MINLEN_SET 2
#define BT_MESH_DEVICE_SETTINGS_MSG_MAXLEN_SET 5 // DO: fix values
#define BT_MESH_DEVICE_SETTINGS_MSG_MINLEN_STATUS 2

/** TXP values */
struct bt_mesh_settings_txp {
	/**< 0 dBm. */
	nrf_radio_txpower_t zerodB;
	/**< -4 dBm. */
	nrf_radio_txpower_t neg4dB;
	/**< -12 dBm. */
	nrf_radio_txpower_t neg12dB;
    /**< -20 dBm. */
    nrf_radio_txpower_t neg20dB;
};

/** Mandatory parameters for the Settings Set message. */
struct bt_mesh_settings_set {
	/** State to set. */
	nrf_radio_txpower_t txp_value; // TXP value
	/** Transition parameters. */
	const struct bt_mesh_model_transition *transition;
};

/** Parameters for the Settings Status message. */
struct bt_mesh_settings_status {
	/** The present value of the Generic OnOff state. */
	
    // DO: add present value... type (?) 

	/** Remaining time value in milliseconds. */
	int32_t remaining_time;
};
```

## src/settings_srv.c
```c
#include <string.h>
#include "settings_srv.h"
#include "model_utils.h"
#include <bluetooth/mesh/models.h>

#include <zephyr/types.h>
#include <stddef.h>
#include <sys/printk.h>
#include <sys/util.h>
#include <sys/byteorder.h>

#include <bluetooth/bluetooth.h>
#include <bluetooth/hci.h>
#include <bluetooth/hci_vs.h>

#include <bluetooth/conn.h>
#include <bluetooth/uuid.h>
#include <bluetooth/gatt.h>
#include <bluetooth/services/hrs.h>


/* Receiving messages - Message handlers: bt_mesh_model_op.func, used to process the received message
*/

static void handle_get_message(struct bt_mesh_model *model,
                                  struct bt_mesh_msg_ctx *ctx,
                                  struct net_buf_simple *buf)
{
    if (buf->len != BT_MESH_DEVICE_SETTINGS_MSG_MINLEN_GET {
		return;
	}
    send_status_message(model, &ctx, &buf);

}

static void handle_set_message(struct bt_mesh_model *model,
                                  struct bt_mesh_msg_ctx *ctx,
                                  struct net_buf_simple *buf)
{
    if (buf->len < BT_MESH_DEVICE_SETTINGS_MSG_MINLEN_SET || 
		buf->len > BT_MESH_DEVICE_SETTINGS_MSG_MAXLEN_SET{
		return;
	}
    uint8_t txp_value = net_buf_simple_pull_u8(buf);
    set_tx_power(BT_HCI_VS_LL_HANDLE_TYPE_ADV, 0, txp_value); // DO: check handle type

    // DO: add ACK OPCODE to list...
    BT_MESH_MODEL_BUF_DEFINE(reply, MESSAGE_ACK_OPCODE, MESSAGE_ACK_LEN);
    bt_mesh_model_msg_init(&reply, MESSAGE_ACK_OPCODE);

    // DO: Fill the reply buffer here...

    (void) bt_mesh_model_send(model, ctx, &reply, NULL, NULL);
}

// OPcode list: defines a list of messages that the server will receive
const struct bt_mesh_model_op _bt_mesh_settings_srv_op[] = {
    { BT_MESH_DEVICE_SETTINGS_GET_OP,    BT_MESH_DEVICE_SETTINGS_MSG_MINLEN_GET,    handle_get_message },
    { BT_MESH_DEVICE_SETTINGS_SET_OP,    BT_MESH_DEVICE_SETTINGS_MSG_MINLEN_SET,    handle_set_message },
    BT_MESH_MODEL_OP_END,
}

/* Sending messages */

static int send_status_message(struct bt_mesh_model *model,
		       struct bt_mesh_msg_ctx *rx_ctx,
		       const struct bt_mesh_settings_status *status)
{
    // prepare a buffer that will contain the message data together with the opcode:
    BT_MESH_MODEL_BUF_DEFINE(buf, 
        BT_MESH_DEVICE_SETTINGS_STATUS_OP,
        BT_MESH_DEVICE_SETTINGS_MSG_MINLEN_STATUS);
    // set the opcode of the message:
    bt_mesh_model_msg_init(&buf, BT_MESH_DEVICE_SETTINGS_STATUS_OP);

    int8_t txp_get = 0xFF;
	get_tx_power(BT_HCI_VS_LL_HANDLE_TYPE_ADV, 0, &txp_get); // DO: check handle type
	net_buf_simple_add_u8(buf, txp_get);

    return bt_mesh_model_send(model, &ctx, &buf, NULL, NULL);
}

/* ONOFF SERVER:

static void rsp_status(struct bt_mesh_model *model,
		       struct bt_mesh_msg_ctx *rx_ctx,
		       const struct bt_mesh_onoff_status *status)
{
	BT_MESH_MODEL_BUF_DEFINE(msg, BT_MESH_ONOFF_OP_STATUS,
				 BT_MESH_ONOFF_MSG_MAXLEN_STATUS);
	encode_status(&msg, status);

	(void)bt_mesh_model_send(model, rx_ctx, &msg, NULL, NULL);
}

*/


/* Callbacks: -> Additional model initialization */
static int bt_mesh_settings_srv_init(struct bt_mesh_model *model)
{
	struct bt_mesh_settings_srv *srv = model->user_data;

	srv->model = model;
	net_buf_simple_init(model->pub->msg, 0);

	if (IS_ENABLED(CONFIG_BT_SETTINGS)) { 
		// DO: (?) research...
	}

	return 0;
}

const struct bt_mesh_model_cb _bt_mesh_settings_srv_cb = {
	.init = bt_mesh_settings_srv_init,
};



// TX POWER
/** Functions form Bluetooth: HCI Power Control
Source: zephyr/samples/bluetooth/hci_pwr_ctrl/src/main.c

Note: stop advertising before changing the transmit power then restart advertising
*/

static void set_tx_power(uint8_t handle_type, uint16_t handle, int8_t tx_pwr_lvl)
{
	struct bt_hci_cp_vs_write_tx_power_level *cp; // command power (?)
	struct bt_hci_rp_vs_write_tx_power_level *rp; // real power (?)
	struct net_buf *buf, *rsp = NULL;
	int err;

	// Allocate a HCI command buffer
	buf = bt_hci_cmd_create(BT_HCI_OP_VS_WRITE_TX_POWER_LEVEL,
				sizeof(*cp));
	if (!buf) {
		printk("Unable to allocate command buffer\n");
		return;
	}

	cp = net_buf_add(buf, sizeof(*cp));
	cp->handle = sys_cpu_to_le16(handle);
	cp->handle_type = handle_type;
	cp->tx_power_level = tx_pwr_lvl;

	//Send a HCI command synchronously
	err = bt_hci_cmd_send_sync(BT_HCI_OP_VS_WRITE_TX_POWER_LEVEL,
				   buf, &rsp);
	if (err) {
		uint8_t reason = rsp ?
			((struct bt_hci_rp_vs_write_tx_power_level *)
			  rsp->data)->status : 0;
		printk("Set Tx power err: %d reason 0x%02x\n", err, reason);
		return;
	}

	rp = (void *)rsp->data;
	printk("Actual Tx Power: %d\n", rp->selected_tx_power);

	net_buf_unref(rsp);
}


static void get_tx_power(uint8_t handle_type, uint16_t handle, int8_t *tx_pwr_lvl)
{
	struct bt_hci_cp_vs_read_tx_power_level *cp;
	struct bt_hci_rp_vs_read_tx_power_level *rp;
	struct net_buf *buf, *rsp = NULL;
	int err;

	*tx_pwr_lvl = 0xFF;
	buf = bt_hci_cmd_create(BT_HCI_OP_VS_READ_TX_POWER_LEVEL,
				sizeof(*cp));
	if (!buf) {
		printk("Unable to allocate command buffer\n");
		return;
	}

	cp = net_buf_add(buf, sizeof(*cp));
	cp->handle = sys_cpu_to_le16(handle);
	cp->handle_type = handle_type;

	err = bt_hci_cmd_send_sync(BT_HCI_OP_VS_READ_TX_POWER_LEVEL,
				   buf, &rsp);
	if (err) {
		uint8_t reason = rsp ?
			((struct bt_hci_rp_vs_read_tx_power_level *)
			  rsp->data)->status : 0;
		printk("Read Tx power err: %d reason 0x%02x\n", err, reason);
		return;
	}

	rp = (void *)rsp->data;
	*tx_pwr_lvl = rp->tx_power_level;

	net_buf_unref(rsp);
}

static void read_conn_rssi(uint16_t handle, int8_t *rssi)
{
	struct net_buf *buf, *rsp = NULL;
	struct bt_hci_cp_read_rssi *cp;
	struct bt_hci_rp_read_rssi *rp;

	int err;

	buf = bt_hci_cmd_create(BT_HCI_OP_READ_RSSI, sizeof(*cp));
	if (!buf) {
		printk("Unable to allocate command buffer\n");
		return;
	}

	cp = net_buf_add(buf, sizeof(*cp));
	cp->handle = sys_cpu_to_le16(handle);

	err = bt_hci_cmd_send_sync(BT_HCI_OP_READ_RSSI, buf, &rsp);
	if (err) {
		uint8_t reason = rsp ?
			((struct bt_hci_rp_read_rssi *)rsp->data)->status : 0;
		printk("Read RSSI err: %d reason 0x%02x\n", err, reason);
		return;
	}

	rp = (void *)rsp->data;
	*rssi = rp->rssi;

	net_buf_unref(rsp);
}
```

## src/settings_srv.h
```c
#include <bluetooth/mesh/model_types.h>
#include "settings_mod.h"

#include <zephyr/types.h>
#include <stddef.h>
#include <sys/printk.h>
#include <sys/util.h>
#include <sys/byteorder.h>

#include <bluetooth/bluetooth.h>
#include <bluetooth/hci.h>
#include <bluetooth/hci_vs.h>

#include <bluetooth/conn.h>
#include <bluetooth/uuid.h>
#include <bluetooth/gatt.h>
#include <bluetooth/services/hrs.h>

#ifdef __cplusplus
extern "C" {
#endif

// Node composition data - The node composition data is passed to bt_mesh_init()

extern const struct bt_mesh_model_op _bt_mesh_settings_srv_op[];
extern const struct bt_mesh_model_cb _bt_mesh_settings_srv_cb;

#define BT_MESH_MODEL_SETTINGS_SRV(_srv)	
    BT_MESH_MODEL_VND_CB(
        BT_MESH_NORDIC_SEMI_COMPANY_ID, BT_MESH_MODEL_ID_SETTINGS_MOD,
        _bt_mesh_settings_srv_op,
        NULL,
        NULL,
        NULL)


/* Message handlers */

static void handle_message_get(struct bt_mesh_model *model,
                                  struct bt_mesh_msg_ctx *ctx,
                                  struct net_buf_simple *buf);

static void handle_message_set(struct bt_mesh_model *model,
                                  struct bt_mesh_msg_ctx *ctx,
                                  struct net_buf_simple *buf);                                



/* GET AND SET TX POWER LEVEL ON LOCAL SERVER */ 
static void set_tx_power(uint8_t handle_type, uint16_t handle, int8_t txp_lvl):
static void get_tx_power(uint8_t handle_type, uint16_t handle, int8_t *txp_lvl);
// DO: Add helper functions from hci_pwr_ctrl.h /.c 
```

## src/txp_ctrl_cli.c
```c
// #include <zephyr.h>
// #include <sys/printk.h>

#include <string.h>
#include "model_utils.h"
#include "txp_ctrl_cli.h"
#include "txp_ctrl.h"

#include <zephyr/types.h>
#include <stddef.h>
#include <sys/printk.h>
#include <sys/util.h>
#include <sys/byteorder.h>

#include <bluetooth/bluetooth.h>
#include <bluetooth/hci.h>
#include <bluetooth/hci_vs.h>

#include <bluetooth/conn.h>
#include <bluetooth/uuid.h>
#include <bluetooth/gatt.h>
#include <bluetooth/services/hrs.h>

static void decode_status(struct net_buf_simple *buf,
			  struct bt_mesh_txp_ctrl_status *status)
{
	status->present_txp = net_buf_simple_pull_u8(buf);

	if (buf->len == 2) { // (?) Check len value
		status->target_txp = net_buf_simple_pull_u8(buf);
		status->remaining_time =
			model_transition_decode(net_buf_simple_pull_u8(buf));
	} else {
		status->target_txp = status->present_txp;
		status->remaining_time = 0;
	}
}

// STATUS HANDLER
static void handle_status(struct bt_mesh_model *model,
			  struct bt_mesh_msg_ctx *ctx,
			  struct net_buf_simple *buf)
{

	if (buf->len != BT_MESH_TX_PWR_CTRL_MSG_MINLEN_STATUS &&
	    buf->len != BT_MESH_TX_PWR_CTRL_MSG_MAXLEN_STATUS) { // check values
		return;
	}

	struct bt_mesh_txp_ctrl_cli *cli = model->user_data;
	struct bt_mesh_txp_ctrl_status status;

	decode_status(buf, &status);

	// not complete
}

static int bt_mesh_txp_cli_init(struct bt_mesh_model *model)
{
	struct bt_mesh_txp_cli *cli = model->user_data;

	cli->model = model;
	net_buf_simple_init(cli->pub.msg, 0);
	model_ack_init(&cli->ack_ctx);

	return 0;
}

const struct bt_mesh_model_cb _bt_mesh_txp_cli_cb = {
	.init = bt_mesh_txp_cli_init,
};

//______________________________________________________
int bt_mesh_txp_ctrl_cli_get(struct bt_mesh_txp_ctrl_cli *cli,
			  struct bt_mesh_msg_ctx *ctx,
			  struct bt_mesh_txp_ctrl_status *rsp)
{
	BT_MESH_MODEL_BUF_DEFINE(msg, BT_HCI_OP_VS_READ_TX_POWER_LEVEL,
				 BT_MESH_TX_PWR_CTRL_MSG_LEN_GET);
	bt_mesh_model_msg_init(&msg, BT_HCI_OP_VS_READ_TX_POWER_LEVEL);

	return model_ackd_send(cli->model, ctx, &msg,
			       rsp ? &cli->ack_ctx : NULL,
			       BT_MESH_TX_PWR_CTRL_OP_STATUS, rsp); // FIX: undefined macro
}

//________________________________________________________
int bt_mesh_txp_ctrl_cli_set(struct bt_mesh_txp_ctrl_cli *cli,
			  struct bt_mesh_msg_ctx *ctx,
			  const struct bt_mesh_txp_ctrl_set *set,
			  struct bt_mesh_txp_ctrl_status *rsp)
{
	BT_MESH_MODEL_BUF_DEFINE(msg, BT_HCI_OP_VS_WRITE_TX_POWER_LEVEL,
				 BT_MESH_TX_PWR_CTRL_MSG_MAXLEN_SET);
	bt_mesh_model_msg_init(&msg, BT_HCI_OP_VS_WRITE_TX_POWER_LEVEL);

	net_buf_simple_add_u8(&msg, set->txp);
	net_buf_simple_add_u8(&msg, cli->tid++);
	if (set->transition) {
		model_transition_buf_add(&msg, set->transition);
	}

	return model_ackd_send(cli->model, ctx, &msg,
			       rsp ? &cli->ack_ctx : NULL,
			       BT_MESH_TX_PWR_CTRL_OP_STATUS, rsp); // FIX: undefined macro
}
```

## src/txp_ctrl_cli.h
```c
#include <bluetooth/mesh/txp_ctrl.h> // fix loactaion

/* INIT CLI */

/** Generic TX Power Control Client structure */
struct bt_mesh_txp_ctrl_cli {
	/** @brief TX power control status message handler.
	 *
	 * @param[in] cli Client that received the status message.
	 * @param[in] ctx Context of the incoming message.
	 * @param[in] status Status of the Server that
	 * published the message.
	 */
	void (*const status_handler)(struct bt_mesh_txp_ctrl_cli *cli,
				     struct bt_mesh_msg_ctx *ctx,
				     const struct bt_mesh_txp_ctrl_status *status);
	/** Current Transaction ID. */
	uint8_t tid;
	/** Response context for tracking acknowledged messages. */
	struct bt_mesh_model_ack_ctx ack_ctx;
	/** Publish parameters. */
	struct bt_mesh_model_pub pub;
	/** Access model pointer. */
	struct bt_mesh_model *model;
};

static int bt_mesh_txp_cli_init(struct bt_mesh_model *model);

/* SEND MESSAGE */

/** @brief Get the status of the bound srv.*/
int bt_mesh_txp_ctrl_cli_get(struct bt_mesh_txp_ctrl_cli *cli,
			  struct bt_mesh_msg_ctx *ctx,
			  struct bt_mesh_txp_ctrl_status *rsp);

/** @brief Set the state in the srv (optional unack: without requesting a response).*/
int bt_mesh_txp_ctrl_cli_set(struct bt_mesh_txp_ctrl_cli *cli,
			  struct bt_mesh_msg_ctx *ctx,
			  const struct bt_mesh_txp_ctrl_set *set,
			  struct bt_mesh_txp_ctrl_status *rsp); // remove for unack


/* STATUS HANDLER */
```

## src/txp_ctrl_srv.c
```c
// #include <zephyr.h>
//#include <sys/printk.h>
#include "txp_ctrl_srv.h"

static void rsp_status(struct bt_mesh_model *model,
		       struct bt_mesh_msg_ctx *rx_ctx,
		       const struct bt_mesh_txp_ctrl_status *status)
{
	BT_MESH_MODEL_BUF_DEFINE(msg, BT_MESH_TX_PWR_CTRL_OP_STATUS,
				 BT_MESH_TX_PWR_CTRL_MSG_MAXLEN_STATUS);
	encode_status(&msg, status);

	(void)bt_mesh_model_send(model, rx_ctx, &msg, NULL, NULL);
}

//______________________________________________________
static void handle_set(struct bt_mesh_model *model, struct bt_mesh_msg_ctx *ctx,
		       struct net_buf_simple *buf)
{
	// extract from buffer...

	set_tx_power(uint8_t handle_type, uint16_t handle, int8_t tx_pwr_lvl); // DO: fix parameters...
}

//______________________________________________________
static void handle_get(struct bt_mesh_model *model, struct bt_mesh_msg_ctx *ctx,
		       struct net_buf_simple *buf)
{
	if (buf->len != BT_MESH_TX_PWR_CTRL_MSG_LEN_GET) {
		return;
	}

	//struct bt_mesh_txp_ctrl_srv *srv = model->user_data;
	struct bt_mesh_txp_ctrl_status status = { 0 };

	// Get status update
    get_tx_power(BT_HCI_VS_LL_HANDLE_TYPE_ADV, 0, &status->present_txp);

	// Send status response
	rsp_status(model, ctx, &status);
}

// TX POWER
/** Set and get functions form Bluetooth: HCI Power Control
Source: zephyr/samples/bluetooth/hci_pwr_ctrl/src/main.c

Note: stop advertising before changing the transmit power then restart advertising
*/

static void set_tx_power(uint8_t handle_type, uint16_t handle, int8_t tx_pwr_lvl)
{
	struct bt_hci_cp_vs_write_tx_power_level *cp; // command power (?)
	struct bt_hci_rp_vs_write_tx_power_level *rp; // real power (?)
	struct net_buf *buf, *rsp = NULL;
	int err;

	// Allocate a HCI command buffer
	buf = bt_hci_cmd_create(BT_HCI_OP_VS_WRITE_TX_POWER_LEVEL,
				sizeof(*cp));
	if (!buf) {
		printk("Unable to allocate command buffer\n");
		return;
	}

	cp = net_buf_add(buf, sizeof(*cp));
	cp->handle = sys_cpu_to_le16(handle);
	cp->handle_type = handle_type;
	cp->tx_power_level = tx_pwr_lvl;

	//Send a HCI command synchronously
	err = bt_hci_cmd_send_sync(BT_HCI_OP_VS_WRITE_TX_POWER_LEVEL,
				   buf, &rsp);
	if (err) {
		uint8_t reason = rsp ?
			((struct bt_hci_rp_vs_write_tx_power_level *)
			  rsp->data)->status : 0;
		printk("Set Tx power err: %d reason 0x%02x\n", err, reason);
		return;
	}

	rp = (void *)rsp->data;
	printk("Actual Tx Power: %d\n", rp->selected_tx_power);

	net_buf_unref(rsp);
}

//______________________________________________________
static void get_tx_power(uint8_t handle_type, uint16_t handle, int8_t *tx_pwr_lvl)
{
	struct bt_hci_cp_vs_read_tx_power_level *cp;
	struct bt_hci_rp_vs_read_tx_power_level *rp;
	struct net_buf *buf, *rsp = NULL;
	int err;

	*tx_pwr_lvl = 0xFF;
	buf = bt_hci_cmd_create(BT_HCI_OP_VS_READ_TX_POWER_LEVEL,
				sizeof(*cp));
	if (!buf) {
		printk("Unable to allocate command buffer\n");
		return;
	}

	cp = net_buf_add(buf, sizeof(*cp));
	cp->handle = sys_cpu_to_le16(handle);
	cp->handle_type = handle_type;

	err = bt_hci_cmd_send_sync(BT_HCI_OP_VS_READ_TX_POWER_LEVEL,
				   buf, &rsp);
	if (err) {
		uint8_t reason = rsp ?
			((struct bt_hci_rp_vs_read_tx_power_level *)
			  rsp->data)->status : 0;
		printk("Read Tx power err: %d reason 0x%02x\n", err, reason);
		return;
	}

	rp = (void *)rsp->data;
	*tx_pwr_lvl = rp->tx_power_level;

	net_buf_unref(rsp);
}
```

## src/txp_ctrl_srv.h
```c
#include <zephyr/types.h>
#include <stddef.h>
#include <sys/printk.h>
#include <sys/util.h>
#include <sys/byteorder.h>

#include <bluetooth/bluetooth.h>
#include <bluetooth/hci.h>
#include <bluetooth/hci_vs.h>

#include <bluetooth/conn.h>
#include <bluetooth/uuid.h>
#include <bluetooth/gatt.h>
#include <bluetooth/services/hrs.h>

#include "txp_ctrl.h"

/* INIT SRV */
/**
 * Generic Tx power control Server instance. Should primarily be initialized with the
 * @ref BT_MESH_TXP_CTRL_SRV_INIT macro.
 */
struct bt_mesh_txp_ctrl_srv {
	/** Transaction ID tracker. */
	struct bt_mesh_tid_ctx prev_transaction;
	/** Handler function structure. */
	const struct bt_mesh_txp_ctrl_srv_handlers *handlers; // check
	/** Access model pointer. */
	struct bt_mesh_model *model;
	/** Publish parameters. */
	struct bt_mesh_model_pub pub;
	/* Scene entry */
	//struct bt_mesh_scene_entry scene;
};

/* GET AND SET TX POWER LEVEL ON LOCAL SERVER */ 
static void set_tx_power(uint8_t handle_type, uint16_t handle, int8_t txp_lvl):
static void get_tx_power(uint8_t handle_type, uint16_t handle, int8_t *txp_lvl);
// Add helper functions from hci_pwr_ctrl.h /.c 

/* MESSAGE HANDLERS */
static void handle_set(struct bt_mesh_model *model, struct bt_mesh_msg_ctx *ctx,
		       struct net_buf_simple *buf);
static void handle_get(struct bt_mesh_model *model, struct bt_mesh_msg_ctx *ctx,
		       struct net_buf_simple *buf);

/* SEND RESPONSE MESSAGE */
static void rsp_status(struct bt_mesh_model *model,
		       struct bt_mesh_msg_ctx *rx_ctx,
		       const struct bt_mesh_txp_ctrl_status *status);
```
